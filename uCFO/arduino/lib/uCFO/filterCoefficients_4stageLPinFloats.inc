// value of x for implementation of four stage  low pass filter
// in single precision float calculation with coefficients
// a0 = (1 - x)^4
// b1 = 4x
// b2 = -6x^2
// b3 = 4x^3
// b4 = -x^4
// x = EXP(-(14.445 * fc))
// where fc is a value between 0.0 and 0.5 of the sampling rate (in this case 48KHz)
//

// a0
0.000000004613731727365660000000,0.000000005176230969328230000000,0.000000005807226140952210000000,0.000000006515048838524650000000,0.000000007309033784469370000000,0.000000008199653346037200000000,0.000000009198656401868580000000,0.000000010319197204301000000000,0.000000011576043086155800000000,0.000000012985747553178700000000,0.000000014566860505508300000000,0.000000016340190907999300000000,0.000000018329045066453400000000,0.000000020559576229388400000000,0.000000023061088831002400000000,0.000000025866440936143500000000,0.000000029012433980626000000000,0.000000032540341789532600000000,0.000000036496442894391300000000,0.000000040932543797034500000000,0.000000045906768675514200000000,0.000000051484195885369700000000,0.000000057737832333602400000000,0.000000064749357492340500000000,0.000000072610429362990600000000,0.000000081423638133443600000000,0.000000091304021339414800000000,0.000000102380331165032000000000,0.000000114796890171546000000000,0.000000128715420277157000000000,0.000000144316867145311000000000,0.000000161804139943715000000000,0.000000181404203016005000000000,0.000000203371475095039000000000,0.000000227990777406150000000000,0.000000255581226781474000000000,0.000000286499483895789000000000,0.000000321145721242199000000000,0.000000359967372437236000000000,0.000000403465340266089000000000,0.000000452200547927312000000000,0.000000506800318683209000000000,0.000000567967726558461000000000,0.000000636487788494692000000000,0.000000713240655118326000000000,0.000000799209798577538000000000,0.000000895496399069103000000000,0.000001003331603950610000000000,0.000001124092502013200000000000,0.000001259319671833220000000000,0.000001410734501348690000000000,0.000001580264444387730000000000,0.000001770060863504200000000000,0.000001982531475344610000000000,0.000002220365980485000000000000,0.000002486571810667770000000000,0.000002784508975628030000000000,0.000003117928794874210000000000,0.000003491026435221470000000000,0.000003908486382241310000000000,0.000004375539162796580000000000,0.000004898027085208320000000000,0.000005482472149134200000000000,0.000006136153317170690000000000,0.000006867201420418480000000000,0.000007684681501186200000000000,0.000008598717579921850000000000,0.000009620588238783330000000000,0.000010762890289939900000000000,0.000012039665318136300000000000,0.000013466559942057500000000000,0.000015061030189889800000000000,0.000016842519062503200000000000,0.000018832696705753500000000000,0.000021055703083055900000000000,0.000023538421536655200000000000,0.000026310797604647300000000000,0.000029406131013027100000000000,0.000032861543410688600000000000,0.000036718296288775300000000000,0.000041022279121982200000000000,0.000045824571588262600000000000,0.000051181914276245800000000000,0.000057157397330643100000000000,0.000063821151529730300000000000,0.000071251009054479400000000000,0.000079533421298609000000000000,0.000088764451498592700000000000,0.000099050561288766200000000000,0.000110509913742446000000000000,0.000123273580727125000000000000,0.000137486856384098000000000000,0.000153310638528679000000000000,0.000170923384528625000000000000,0.000190522465115459000000000000,0.000212326462103198000000000000,0.000236577155410040000000000000,0.000263541948221230000000000000,0.000293516598717711000000000000,0.000326827325550388000000000000,0.000363835112450333000000000000,0.000404938009049899000000000000,0.000450575008052283000000000000,0.000501230971259985000000000000,0.000557439031216422000000000000,0.000619787328152427000000000000,0.000688923168284303000000000000,0.000765558004895797000000000000,0.000850475611829806000000000000,0.000944535375695951000000000000,0.001048682332647230000000000000,0.001163953342688260000000000000,0.001291484420910980000000000000,0.001432521539796840000000000000,0.001588427922647640000000000000,0.001760697636941340000000000000,0.001950960126048560000000000000,0.002160999094162740000000000000,0.002392759322762610000000000000,0.002648361707691960000000000000,0.002930119982139650000000000000,0.003240547487756420000000000000,0.003582379857970010000000000000,0.003958591381161600000000000000,0.004372406516262540000000000000,0.004827322723475290000000000000,0.005327124180484900000000000000,0.005875910729101420000000000000,0.006478103938605880000000000000,0.007138481353571250000000000000,0.007862181370412810000000000000,0.008654744553847910000000000000,0.009522120519738140000000000000,0.010470695422754600000000000000,0.011507310414573300000000000000,0.012639278534611300000000000000,0.013874428341592400000000000000,0.015221087490177100000000000000,0.016688126580173800000000000000,0.018284984894894600000000000000,0.020021640737514800000000000000,0.021908690187039200000000000000,0.023957286281626800000000000000,0.026179209284143200000000000000,0.028586831909591500000000000000,0.031193123851377600000000000000,0.034011669977441800000000000000,0.037056593315000500000000000000,0.040342643303444900000000000000,0.043885077727601000000000000000,0.047699678565973200000000000000,0.051802651124936100000000000000,0.056210697556566900000000000000,0.060940868731794800000000000000,0.066010457942272800000000000000,0.071437004395611600000000000000,0.077238240024062700000000000000,0.083431806842929100000000000000,0.090035386976970300000000000000,0.097066356818964800000000000000,0.104541820759649000000000000000,0.112478432281249000000000000000,0.120892013350121000000000000000,0.129797843192465000000000000000,0.139210032988202000000000000000,0.149141615480298000000000000000,0.159604156590397000000000000000,0.170607790355494000000000000000,0.182160849726121000000000000000,0.194269687160368000000000000000,0.206938439412508000000000000000,0.220169049524868000000000000000,0.233960720424579000000000000000,0.248310098956965000000000000000,0.263210818016032000000000000000,0.278653468361157000000000000000,0.294625507645715000000000000000,0.311111065642452000000000000000,0.328090939455693000000000000000,0.345542529770487000000000000000,0.363439594667802000000000000000,0.381752747899152000000000000000,0.400449058025762000000000000000,0.419492260209973000000000000000,0.438843126313668000000000000000,0.458459416647719000000000000000,0.478295985438578000000000000000,0.498305503110738000000000000000,0.518438179828263000000000000000,0.538642504565039000000000000000,0.558865594131836000000000000000,0.579053306795471000000000000000,0.599151086777235000000000000000,0.619104122880539000000000000000,0.638857815771724000000000000000,0.658358458481038000000000000000,0.677553584366236000000000000000,0.696392305241026000000000000000,0.714826044930909000000000000000,0.732808788519859000000000000000,0.750297637857153000000000000000,0.767252840469215000000000000000,0.783638536854628000000000000000,0.799423073031810000000000000000,0.814578486172380000000000000000,0.829081814464901000000000000000,0.842914224718520000000000000000,0.856061784054115000000000000000,0.868514982056019000000000000000,0.880268985313666000000000000000,0.891323421471368000000000000000,0.901682153994239000000000000000,0.911353224775040000000000000000,0.920348419759477000000000000000,0.928683141579872000000000000000,0.936376034502292000000000000000,0.943448570973194000000000000000,0.949924731799648000000000000000,0.955830689950577000000000000000,0.961194276495881000000000000000,0.966044726527294000000000000000,0.970412260818434000000000000000,0.974327695231791000000000000000,0.977822074590333000000000000000,0.980926430451191000000000000000,0.983671429186012000000000000000,0.986087072622550000000000000000,0.988202518372260000000000000000,0.990045800750474000000000000000,0.991643749663706000000000000000,0.993021758976086000000000000000,0.994203739035142000000000000000,0.995212001250006000000000000000,0.996067230993009000000000000000,0.996788466633002000000000000000,0.997393090381519000000000000000,0.997896872599435000000000000000,0.998314006753347000000000000000,0.998657176451572000000000000000,0.998937635556803000000000000000,0.999165286302675000000000000000,0.999348785511623000000000000000,0.999495635960190000000000000000,0.999612290212276000000000000000,0.999704255031274000000000000000,0.999776190362342000000000000000,0.999832007214173000000000000000,0.999874959948381000000000000000,0.999907732553278000000000000000,0.999932519529119000000000000000,0.999951098146747000000000000000,0.999964894621099000000000000000,0.999975042376996000000000000000,0.999982433282298000000000000000,0.999987762049658000000000000000,0.999991564199853000000000000000,

// b1
3.967033482189860000000000000000,3.966071598170450000000000000000,3.965081773646280000000000000000,3.964063199371980000000000000000,3.963015054450190000000000000000,3.961936487332910000000000000000,3.960826615929470000000000000000,3.959684553935640000000000000000,3.958509370411140000000000000000,3.957300112551720000000000000000,3.956055808187760000000000000000,3.954775448051170000000000000000,3.953458009724340000000000000000,3.952102424459920000000000000000,3.950707602332880000000000000000,3.949272418128150000000000000000,3.947795729343890000000000000000,3.946276349034510000000000000000,3.944713050777200000000000000000,3.943104597370600000000000000000,3.941449693560520000000000000000,3.939747027816180000000000000000,3.937995228684510000000000000000,3.936192921959340000000000000000,3.934338659835870000000000000000,3.932430980453570000000000000000,3.930468360828530000000000000000,3.928449260971590000000000000000,3.926372081631310000000000000000,3.924235172967370000000000000000,3.922036870363820000000000000000,3.919775429873040000000000000000,3.917449097119120000000000000000,3.915056040487720000000000000000,3.912594389374030000000000000000,3.910062206420350000000000000000,3.907457558663380000000000000000,3.904778388655110000000000000000,3.902022630388580000000000000000,3.899188158146940000000000000000,3.896272774293780000000000000000,3.893274251050760000000000000000,3.890190249194550000000000000000,3.887018454753800000000000000000,3.883756410029400000000000000000,3.880401649119030000000000000000,3.876951605285490000000000000000,3.873403670395470000000000000000,3.869755166747000000000000000000,3.866003335392940000000000000000,3.862145383868520000000000000000,3.858178382752080000000000000000,3.854099412295960000000000000000,3.849905418554240000000000000000,3.845593303123310000000000000000,3.841159866718590000000000000000,3.836601845584080000000000000000,3.831915936201840000000000000000,3.827098693209370000000000000000,3.822146612218740000000000000000,3.817056120214990000000000000000,3.811823543184590000000000000000,3.806445131397120000000000000000,3.800917061719950000000000000000,3.795235371504450000000000000000,3.789396075666290000000000000000,3.783395032346430000000000000000,3.777228105532050000000000000000,3.770890963111110000000000000000,3.764379216964560000000000000000,3.757688426123140000000000000000,3.750813987170680000000000000000,3.743751251374920000000000000000,3.736495449566250000000000000000,3.729041719090060000000000000000,3.721385108283850000000000000000,3.713520536438890000000000000000,3.705442921802260000000000000000,3.697146929878400000000000000000,3.688627236020540000000000000000,3.679878430384790000000000000000,3.670894913435210000000000000000,3.661671079852530000000000000000,3.652201181323800000000000000000,3.642479334294510000000000000000,3.632499659230980000000000000000,3.622256145484940000000000000000,3.611742584042100000000000000000,3.600952837933170000000000000000,3.589880611355590000000000000000,3.578519492695920000000000000000,3.566862997369200000000000000000,3.554904642522170000000000000000,3.542637700956430000000000000000,3.530055534461910000000000000000,3.517151349251090000000000000000,3.503918315864400000000000000000,3.490349529646000000000000000000,3.476437951983300000000000000000,3.462176739363260000000000000000,3.447558693638350000000000000000,3.432576749704150000000000000000,3.417223855277330000000000000000,3.401492680632660000000000000000,3.385376254475610000000000000000,3.368867325818390000000000000000,3.351958693558690000000000000000,3.334643327074970000000000000000,3.316913885263290000000000000000,3.298763443578290000000000000000,3.280184856390620000000000000000,3.261171084089440000000000000000,3.241715315743660000000000000000,3.221810652468520000000000000000,3.201450449535530000000000000000,3.180627872213590000000000000000,3.159336697310650000000000000000,3.137570432290960000000000000000,3.115322981595590000000000000000,3.092588421998200000000000000000,3.069360798693930000000000000000,3.045634813127700000000000000000,3.021405208497460000000000000000,2.996666853466050000000000000000,2.971415147099320000000000000000,2.945645697006850000000000000000,2.919354631414780000000000000000,2.892538114099400000000000000000,2.865193096091830000000000000000,2.837316662279080000000000000000,2.808906770830920000000000000000,2.779961446041940000000000000000,2.750479430563100000000000000000,2.720459982303280000000000000000,2.689903011125050000000000000000,2.658809209925270000000000000000,2.627179468020070000000000000000,2.595015891996140000000000000000,2.562321137254010000000000000000,2.529098324043430000000000000000,2.495352016648940000000000000000,2.461086906269960000000000000000,2.426309232294310000000000000000,2.391025643059480000000000000000,2.355243928139770000000000000000,2.318972923520440000000000000000,2.282222221122640000000000000000,2.245003057665530000000000000000,2.207326994102820000000000000000,2.169207143073740000000000000000,2.130657609512810000000000000000,2.091694122432500000000000000000,2.052332869473070000000000000000,2.012591460511630000000000000000,1.972489193085750000000000000000,1.932046352227370000000000000000,1.891284046824350000000000000000,1.850225517467940000000000000000,1.808894443442060000000000000000,1.767316444140310000000000000000,1.725517989296560000000000000000,1.683526667273600000000000000000,1.641372303814570000000000000000,1.599084583169820000000000000000,1.556695328054890000000000000000,1.514237098915210000000000000000,1.471744034098560000000000000000,1.429250820418960000000000000000,1.386793365058360000000000000000,1.344408612255430000000000000000,1.302134566646490000000000000000,1.260009492639830000000000000000,1.218073004754590000000000000000,1.176364801186850000000000000000,1.134925462243710000000000000000,1.093795943788980000000000000000,1.053017361644420000000000000000,1.012631096731080000000000000000,0.972678462753104000000000000000,0.933200608287723000000000000000,0.894238863354069000000000000000,0.855833513351410000000000000000,0.818024653791738000000000000000,0.780851735938396000000000000000,0.744352948444269000000000000000,0.708565509855335000000000000000,0.673525678856731000000000000000,0.639267760605051000000000000000,0.605824958476150000000000000000,0.573228497932786000000000000000,0.541507527700213000000000000000,0.510689415442825000000000000000,0.480798944873432000000000000000,0.451858629176645000000000000000,0.423888556388324000000000000000,0.396905968441230000000000000000,0.370925338440070000000000000000,0.345958442667148000000000000000,0.322013902759242000000000000000,0.299097373660380000000000000000,0.277211307557855000000000000000,0.256355357369746000000000000000,0.236525847975935000000000000000,0.217715778308292000000000000000,0.199915750085903000000000000000,0.183112684517274000000000000000,0.167291083552773000000000000000,0.152432312506896000000000000000,0.138515286279969000000000000000,0.125516270439138000000000000000,0.113409175890776000000000000000,0.102165817437249000000000000000,0.091755953510471400000000000000,0.082147702989241400000000000000,0.073307600638999400000000000000,0.065200896215655700000000000000,0.057791871564358200000000000000,0.051044042901494300000000000000,0.044920350022800500000000000000,0.039383564427277500000000000000,0.034396402709336800000000000000,0.029921811013169600000000000000,0.025923222790015200000000000000,0.022364796271818500000000000000,0.019211533040953700000000000000,0.016429517313042500000000000000,0.013986110772290900000000000000,0.011850036464975500000000000000,0.009991573776262640000000000000,0.008382563807780720000000000000,0.006996576659065250000000000000,0.005808902474049970000000000000,0.004796619689822470000000000000,0.003938582350970370000000000000,0.003215408358781770000000000000,0.002609461992584920000000000000,0.002104788117744180000000000000,0.001687060261202450000000000000,0.001343500269242290000000000000,0.001062787937499430000000000000,0.000834975104727819000000000000,0.000651373578932398000000000000,0.000504459461542728000000000000,0.000387766170055980000000000000,0.000295777773793009000000000000,0.000223828424143332000000000000,0.000168003369955191000000000000,0.000125045915176920000000000000,0.000092270639375065300000000000,0.000067482178553169500000000000,0.000048902750050285600000000000,0.000035105841055312200000000000,0.000024957856588586900000000000,0.000017566833424837700000000000,0.000012238006505035000000000000,0.000008435826833623310000000000,

// b2
-5.901507993305770000000000000000,-5.898646470680350000000000000000,-5.895702551888220000000000000000,-5.892673893230720000000000000000,-5.889558120674580000000000000000,-5.886352773622450000000000000000,-5.883055305545730000000000000000,-5.879663162503670000000000000000,-5.876173663362290000000000000000,-5.872584067800710000000000000000,-5.868891584061040000000000000000,-5.865093316690630000000000000000,-5.861186337995070000000000000000,-5.857167590033230000000000000000,-5.853033959674050000000000000000,-5.848782237220410000000000000000,-5.844409170234680000000000000000,-5.839911383605940000000000000000,-5.835285394864500000000000000000,-5.830527699676940000000000000000,-5.825634632575610000000000000000,-5.820602491194920000000000000000,-5.815427407928240000000000000000,-5.810105519581040000000000000000,-5.804632758854660000000000000000,-5.799005031011630000000000000000,-5.793218075802780000000000000000,-5.787267598510590000000000000000,-5.781149146280180000000000000000,-5.774858134782850000000000000000,-5.768389954684960000000000000000,-5.761739782738650000000000000000,-5.754902785694780000000000000000,-5.747873925059770000000000000000,-5.740648070910420000000000000000,-5.733219921778790000000000000000,-5.725584214783350000000000000000,-5.717735349190510000000000000000,-5.709667728024240000000000000000,-5.701375609737500000000000000000,-5.692853074388610000000000000000,-5.684094147710580000000000000000,-5.675092565598130000000000000000,-5.665842175348720000000000000000,-5.656336444666660000000000000000,-5.646568859432130000000000000000,-5.636532656147150000000000000000,-5.626220997687420000000000000000,-5.615626893961910000000000000000,-5.604743170976010000000000000000,-5.593562612301350000000000000000,-5.582077662425780000000000000000,-5.570280854947530000000000000000,-5.558164399429990000000000000000,-5.545720444885060000000000000000,-5.532940920633590000000000000000,-5.519817645577190000000000000000,-5.506342403294110000000000000000,-5.492506652836820000000000000000,-5.478301771985700000000000000000,-5.463719034326520000000000000000,-5.448749521641130000000000000000,-5.433384201876310000000000000000,-5.417613941277680000000000000000,-5.401429321919460000000000000000,-5.384820981853170000000000000000,-5.367779239043870000000000000000,-5.350294560457970000000000000000,-5.332356995877380000000000000000,-5.313956583418030000000000000000,-5.295083365432430000000000000000,-5.275727087383200000000000000000,-5.255877537064230000000000000000,-5.235524341735970000000000000000,-5.214657053517820000000000000000,-5.193265171558810000000000000000,-5.171338040457530000000000000000,-5.148865217525420000000000000000,-5.125835782915990000000000000000,-5.102239082367200000000000000000,-5.078064473404210000000000000000,-5.053301049556690000000000000000,-5.027938161385650000000000000000,-5.001965050823600000000000000000,-4.975370887785960000000000000000,-4.948145165367430000000000000000,-4.920277343813770000000000000000,-4.891756685018680000000000000000,-4.862573002882100000000000000000,-4.832716051420050000000000000000,-4.802175659851740000000000000000,-4.770941865750600000000000000000,-4.739005131534640000000000000000,-4.706355705089200000000000000000,-4.672984528644430000000000000000,-4.638882605077030000000000000000,-4.604041336593770000000000000000,-4.568452439662530000000000000000,-4.532107812746190000000000000000,-4.495000415470490000000000000000,-4.457122854780520000000000000000,-4.418468678478560000000000000000,-4.379032078903670000000000000000,-4.338807171149100000000000000000,-4.297789644137740000000000000000,-4.255975147112520000000000000000,-4.213360156246380000000000000000,-4.169942294552100000000000000000,-4.125719145844650000000000000000,-4.080690096258190000000000000000,-4.034854759535390000000000000000,-3.988213814887900000000000000000,-3.940769320622640000000000000000,-3.892523955134850000000000000000,-3.843481867811710000000000000000,-3.793647623063240000000000000000,-3.743028137615170000000000000000,-3.691630581594940000000000000000,-3.639463979871610000000000000000,-3.586538680454010000000000000000,-3.532865892209650000000000000000,-3.478459280600780000000000000000,-3.423333537725850000000000000000,-3.367504586498300000000000000000,-3.310990491154230000000000000000,-3.253810714610610000000000000000,-3.195986798986100000000000000000,-3.137541278069140000000000000000,-3.078499304209600000000000000000,-3.018887190767440000000000000000,-2.958733967707420000000000000000,-2.898069615554840000000000000000,-2.836926411731510000000000000000,-2.775338443242590000000000000000,-2.713341828472350000000000000000,-2.650974905543790000000000000000,-2.588276983944840000000000000000,-2.525290304892190000000000000000,-2.462058603907010000000000000000,-2.398626874754720000000000000000,-2.335043132622730000000000000000,-2.271355785080030000000000000000,-2.207616184018730000000000000000,-2.143876359662990000000000000000,-2.080190235389710000000000000000,-2.016613282507850000000000000000,-1.953201849969740000000000000000,-1.890014523347840000000000000000,-1.827109672085620000000000000000,-1.764547361085810000000000000000,-1.702388193365570000000000000000,-1.640694113182000000000000000000,-1.579526327669830000000000000000,-1.518946645096620000000000000000,-1.459017606315030000000000000000,-1.399801165183160000000000000000,-1.341358254664600000000000000000,-1.283750424558560000000000000000,-1.227037165318340000000000000000,-1.171277780148280000000000000000,-1.116529624269770000000000000000,-1.062848264783000000000000000000,-1.010288639898580000000000000000,-0.958901814049270000000000000000,-0.908737629145466000000000000000,-0.859842746899179000000000000000,-0.812261438214263000000000000000,-0.766034215375601000000000000000,-0.721198439013713000000000000000,-0.677787943764967000000000000000,-0.635832911120868000000000000000,-0.595358970578429000000000000000,-0.556388191841953000000000000000,-0.518937804551764000000000000000,-0.483020926818412000000000000000,-0.448646087493456000000000000000,-0.415817086471718000000000000000,-0.384533151775046000000000000000,-0.354788771963903000000000000000,-0.326573765740716000000000000000,-0.299873679274791000000000000000,-0.274669125965782000000000000000,-0.250936625329160000000000000000,-0.228648537569252000000000000000,-0.207772991946629000000000000000,-0.188274405658706000000000000000,-0.170113815029783000000000000000,-0.153248726155874000000000000000,-0.137633955117236000000000000000,-0.123221591565854000000000000000,-0.109961400958499000000000000000,-0.097801379642000400000000000000,-0.086687859521777000000000000000,-0.076566082785523700000000000000,-0.067380565588866500000000000000,-0.059075380419101400000000000000,-0.051594602511330100000000000000,-0.044882716519754500000000000000,-0.038884857588839400000000000000,-0.033547214598951400000000000000,-0.028817290889225800000000000000,-0.024644275969563800000000000000,-0.020979178785275700000000000000,-0.017775060046644600000000000000,-0.014987365174653500000000000000,-0.012573845711671100000000000000,-0.010494864988597900000000000000,-0.008713353711074950000000000000,-0.007194931699958140000000000000,-0.005907875304356520000000000000,-0.004823115441084370000000000000,-0.003914195344733000000000000000,-0.003157183126730920000000000000,-0.002530591914903230000000000000,-0.002015251616792630000000000000,-0.001594183825246760000000000000,-0.001252462657091730000000000000,-0.000977060368398598000000000000,-0.000756689192314092000000000000,-0.000581649430124070000000000000,-0.000443667194753577000000000000,-0.000335743040365440000000000000,-0.000252005054932787000000000000,-0.000187569042104979000000000000,-0.000138406125668871000000000000,-0.000101223389677336000000000000,-0.000073354235450546400000000000,-0.000052658761582968300000000000,-0.000037436829947437200000000000,-0.000026350265996818200000000000,-0.000018357031854816200000000000,-0.000012653755482383900000000000,-0.000008627835168297240000000000,-0.000005817161600765750000000000,-0.000003877069092646370000000000,-0.000002553484459029480000000000,-0.000001661299882723900000000000,-0.000001067314621848180000000000,-0.000000676872365045288000000000,-0.000000423569325035356000000000,-0.000000261443784568212000000000,-0.000000159107827249201000000000,-0.000000095429755627492200000000,-0.000000056385975989956300000000,-0.000000032806684301230600000000,-0.000000018787186295432800000000,-0.000000010584424618612800000000,-0.000000005863680338412540000000,-0.000000003192701584006260000000,-0.000000001707691658355700000000,-0.000000000896804610930264000000,-0.000000000462157528575316000000,-0.000000000233585477061177000000,-0.000000000115722613715999000000,-0.000000000056163301206479300000,-0.000000000026686190387579600000,

// b3
3.901913300809180000000000000000,3.899075705835610000000000000000,3.896157121888640000000000000000,3.893155287675980000000000000000,3.890067916048790000000000000000,3.886892638521350000000000000000,3.883627006198430000000000000000,3.880268567818360000000000000000,3.876814751430460000000000000000,3.873262932079530000000000000000,3.869610439791490000000000000000,3.865854508229520000000000000000,3.861992345738910000000000000000,3.858021038839730000000000000000,3.853937626866130000000000000000,3.849739061515410000000000000000,3.845422260465120000000000000000,3.840984028930260000000000000000,3.836421075355270000000000000000,3.831730096282130000000000000000,3.826907639560120000000000000000,3.821950227464110000000000000000,3.816854230863750000000000000000,3.811616037001960000000000000000,3.806231844885270000000000000000,3.800697839959370000000000000000,3.795010059053790000000000000000,3.789164520068960000000000000000,3.783157101283530000000000000000,3.776983568568600000000000000000,3.770639680818450000000000000000,3.764121005616830000000000000000,3.757423120304720000000000000000,3.750541421711190000000000000000,3.743471238935830000000000000000,3.736207756207250000000000000000,3.728746219636490000000000000000,3.721081570594750000000000000000,3.713208781124990000000000000000,3.705122710439380000000000000000,3.696818073632500000000000000000,3.688289564304990000000000000000,3.679531626994390000000000000000,3.670538849550480000000000000000,3.661305487376170000000000000000,3.651825852334100000000000000000,3.642094054915630000000000000000,3.632104177149760000000000000000,3.621850197905420000000000000000,3.611325965502350000000000000000,3.600525337079870000000000000000,3.589441894669060000000000000000,3.578069361562790000000000000000,3.566401206430130000000000000000,3.554430900640670000000000000000,3.542151768210450000000000000000,3.529557094384830000000000000000,3.516640200894450000000000000000,3.503394172252590000000000000000,3.489812093084510000000000000000,3.475887029851860000000000000000,3.461611951251240000000000000000,3.446979807040350000000000000000,3.431983543869040000000000000000,3.416615936538340000000000000000,3.400869916133320000000000000000,3.384738217955150000000000000000,3.368213831106180000000000000000,3.351289467972720000000000000000,3.333957953745140000000000000000,3.316212246273770000000000000000,3.298045158642020000000000000000,3.279449684409590000000000000000,3.260418813164960000000000000000,3.240945617219200000000000000000,3.221023278801360000000000000000,3.200645002351120000000000000000,3.179804362598900000000000000000,3.158494671311460000000000000000,3.136709673984680000000000000000,3.114443320630580000000000000000,3.091689519812410000000000000000,3.068442626138790000000000000000,3.044697111259720000000000000000,3.020447606535140000000000000000,2.995689271170430000000000000000,2.970417474353290000000000000000,2.944627655009100000000000000000,2.918316009064250000000000000000,2.891478942196630000000000000000,2.864113201021560000000000000000,2.836216000590900000000000000000,2.807785223838150000000000000000,2.778818859160070000000000000000,2.749315816299360000000000000000,2.719275368910680000000000000000,2.688697461047960000000000000000,2.657582637331040000000000000000,2.625931933785150000000000000000,2.593747646978350000000000000000,2.561032107768800000000000000000,2.527788809173590000000000000000,2.494022147175720000000000000000,2.459736805890030000000000000000,2.424939167999180000000000000000,2.389635935433750000000000000000,2.353834867470640000000000000000,2.317545041135970000000000000000,2.280775853591450000000000000000,2.243538552351410000000000000000,2.205844913327270000000000000000,2.167707928379740000000000000000,2.129142043745860000000000000000,2.090162523940390000000000000000,2.050786125581240000000000000000,2.011030227878630000000000000000,1.970914359038990000000000000000,1.930458493292230000000000000000,1.889684296197230000000000000000,1.848614666370130000000000000000,1.807273346098530000000000000000,1.765686113507480000000000000000,1.723879630218150000000000000000,1.681881562209060000000000000000,1.639721216219580000000000000000,1.597428921727920000000000000000,1.555036477260100000000000000000,1.512576288562520000000000000000,1.470082492124140000000000000000,1.427589821317560000000000000000,1.385134645830140000000000000000,1.342753633198000000000000000000,1.300484623581450000000000000000,1.258366195364890000000000000000,1.216437725769890000000000000000,1.174739415690100000000000000000,1.133311358294800000000000000000,1.092194745516500000000000000000,1.051430800324840000000000000000,1.011060534824620000000000000000,0.971125764992068000000000000000,0.931667330356831000000000000000,0.892726588107833000000000000000,0.854343891917203000000000000000,0.816559236879542000000000000000,0.779411933224564000000000000000,0.742940110723131000000000000000,0.707181397324695000000000000000,0.672171416730157000000000000000,0.637944789993209000000000000000,0.604534393089851000000000000000,0.571971705542068000000000000000,0.540285633412479000000000000000,0.509503174482374000000000000000,0.479649410163040000000000000000,0.450746789172625000000000000000,0.422814911353885000000000000000,0.395871298929759000000000000000,0.369930118373542000000000000000,0.345003080252037000000000000000,0.321098658710001000000000000000,0.298222232837942000000000000000,0.276376632064672000000000000000,0.255560851269960000000000000000,0.235771270286404000000000000000,0.217000964431316000000000000000,0.199240154303359000000000000000,0.182475838465762000000000000000,0.166692201685778000000000000000,0.151870658146754000000000000000,0.137990002030325000000000000000,0.125026325742849000000000000000,0.112953572774483000000000000000,0.101743361213313000000000000000,0.091365458107128700000000000000,0.081787878449522600000000000000,0.072977101887186500000000000000,0.064898371201904000000000000000,0.057515899552651800000000000000,0.050793139473341500000000000000,0.044693116350748600000000000000,0.039178507180742700000000000000,0.034212057676425500000000000000,0.029756767913454400000000000000,0.025776073193760100000000000000,0.022234125039711900000000000000,0.019096003791807100000000000000,0.016327828330873700000000000000,0.013897014190634600000000000000,0.011772354641030300000000000000,0.009924154395914780000000000000,0.008324354899812490000000000000,0.006946571898567780000000000000,0.005766174201482040000000000000,0.004760308446015570000000000000,0.003907895179379590000000000000,0.003189624233032670000000000000,0.002587925784974220000000000000,0.002086910791736590000000000000,0.001672313963361250000000000000,0.001331413147946220000000000000,0.001052948695549360000000000000,0.000827019675337683000000000000,0.000644985172088643000000000000,0.000499368391783699000000000000,0.000383738440495019000000000000,0.000292616222613767000000000000,0.000221366109311616000000000000,0.000166101337364087000000000000,0.000123589079070386000000000000,0.000091164257899909300000000000,0.000066649494500620300000000000,0.000048281724700061200000000000,0.000034647052168741100000000000,0.000024622210118488700000000000,0.000017323702356431800000000000,0.000012063693502966700000000000,0.000008312185226981310000000000,0.000005665123896203200000000000,0.000003817904634230090000000000,0.000002543425916610960000000000,0.000001674339967133610000000000,0.000001088797197205440000000000,0.000000699157235596333000000000,0.000000443165642726319000000000,0.000000277175238864774000000000,0.000000170990077104675000000000,0.000000104001374159771000000000,0.000000062342141394869600000000,0.000000036813797678387300000000,0.000000021406063434187400000000,0.000000012250738587940600000000,0.000000006897407341466220000000,0.000000003818561668919760000000,0.000000002077726728011600000000,0.000000001110536774082280000000,0.000000000582780708861179000000,0.000000000300104014120066000000,0.000000000151563034113502000000,0.000000000075027394890391800000,0.000000000036383175233380000000,0.000000000017273105811911600000,0.000000000008023407189833140000,0.000000000003644095659082310000,0.000000000001617248008024670000,0.000000000000700851050432323000,0.000000000000296369834160607000,0.000000000000122204879036951000,0.000000000000049098769415006800,0.000000000000019206458900486200,0.000000000000007309368622044380,0.000000000000002704071456780160,0.000000000000000971632139611585,0.000000000000000338813313105965,0.000000000000000114554474251522,0.000000000000000037520013493121,

// b4
-0.967438794306997000000000000000,-0.966500838501938000000000000000,-0.965536349453924000000000000000,-0.964544600332301000000000000000,-0.963524857133442000000000000000,-0.962476360431465000000000000000,-0.961398325780827000000000000000,-0.960289969569520000000000000000,-0.959150470055350000000000000000,-0.957978989816296000000000000000,-0.956774678485071000000000000000,-0.955536655930253000000000000000,-0.954264035797225000000000000000,-0.952955893825992000000000000000,-0.951611292586048000000000000000,-0.950229268289584000000000000000,-0.948808848586757000000000000000,-0.947349026899173000000000000000,-0.945848767764415000000000000000,-0.944307034908335000000000000000,-0.942722746451790000000000000000,-0.941094815569569000000000000000,-0.939422109357859000000000000000,-0.937703504129613000000000000000,-0.935937818476906000000000000000,-0.934123870824948000000000000000,-0.932260435383559000000000000000,-0.930346284910294000000000000000,-0.928380151431556000000000000000,-0.926360735468545000000000000000,-0.924286740814177000000000000000,-0.922156814555366000000000000000,-0.919969613133265000000000000000,-0.917723740510612000000000000000,-0.915417785390211000000000000000,-0.913050296430034000000000000000,-0.910619850016006000000000000000,-0.908124931205075000000000000000,-0.905564043456707000000000000000,-0.902935662314158000000000000000,-0.900238225738219000000000000000,-0.897470174445492000000000000000,-0.894629878558533000000000000000,-0.891715765443343000000000000000,-0.888726165979564000000000000000,-0.885659441230796000000000000000,-0.882513899550369000000000000000,-0.879287853189413000000000000000,-0.875979594783008000000000000000,-0.872587389238952000000000000000,-0.869109519381542000000000000000,-0.865544195259802000000000000000,-0.861889688972084000000000000000,-0.858144208085859000000000000000,-0.854305979244894000000000000000,-0.850373200867268000000000000000,-0.846344078900702000000000000000,-0.842216851730967000000000000000,-0.837989703651575000000000000000,-0.833660841803934000000000000000,-0.829228491279497000000000000000,-0.824690870821789000000000000000,-0.820046219033309000000000000000,-0.815292800464620000000000000000,-0.810428853324758000000000000000,-0.805452694627948000000000000000,-0.800362609975290000000000000000,-0.795156996768504000000000000000,-0.789834198096736000000000000000,-0.784392626956994000000000000000,-0.778830773524423000000000000000,-0.773147119459689000000000000000,-0.767340241239344000000000000000,-0.761408753691942000000000000000,-0.755351338494531000000000000000,-0.749166753947938000000000000000,-0.742853809130087000000000000000,-0.736411473006753000000000000000,-0.729838679817278000000000000000,-0.723134545934313000000000000000,-0.716298299890278000000000000000,-0.709329208262521000000000000000,-0.702226726519947000000000000000,-0.694990399157244000000000000000,-0.687619874195223000000000000000,-0.680115016043031000000000000000,-0.672475809445753000000000000000,-0.664702318484025000000000000000,-0.656794894676608000000000000000,-0.648754012045916000000000000000,-0.640580307446458000000000000000,-0.632274619065884000000000000000,-0.623838045464213000000000000000,-0.615271778411825000000000000000,-0.606577344581951000000000000000,-0.597756439546841000000000000000,-0.588811017474003000000000000000,-0.579743269262737000000000000000,-0.570555589620974000000000000000,-0.561250798196664000000000000000,-0.551831781739079000000000000000,-0.542301818408226000000000000000,-0.532664498557427000000000000000,-0.522923546344856000000000000000,-0.513083217368266000000000000000,-0.503147901467763000000000000000,-0.493122327951237000000000000000,-0.483011631663735000000000000000,-0.472821068621919000000000000000,-0.462556435047212000000000000000,-0.452223692515149000000000000000,-0.441829150923964000000000000000,-0.431379523287794000000000000000,-0.420881742813852000000000000000,-0.410343135227705000000000000000,-0.399771174665926000000000000000,-0.389173878860525000000000000000,-0.378559343082417000000000000000,-0.367936057243970000000000000000,-0.357312769622021000000000000000,-0.346698372564952000000000000000,-0.336102193522157000000000000000,-0.325533680847738000000000000000,-0.315002420557974000000000000000,-0.304518278680937000000000000000,-0.294091226847634000000000000000,-0.283731433869262000000000000000,-0.273449035321881000000000000000,-0.263254387944972000000000000000,-0.253157774182770000000000000000,-0.243169630324048000000000000000,-0.233300208238949000000000000000,-0.223559762932773000000000000000,-0.213958429848338000000000000000,-0.204506218837158000000000000000,-0.195212998606191000000000000000,-0.186088270711628000000000000000,-0.177141420110625000000000000000,-0.168381460252015000000000000000,-0.159816969008212000000000000000,-0.151456289755794000000000000000,-0.143307141733793000000000000000,-0.135376922665040000000000000000,-0.127672384597829000000000000000,-0.120199761539186000000000000000,-0.112964698088530000000000000000,-0.105972151853478000000000000000,-0.099226524957382700000000000000,-0.092731382050800800000000000000,-0.086489649708746700000000000000,-0.080503487803068700000000000000,-0.074774365917502400000000000000,-0.069302872772281600000000000000,-0.064088858629174400000000000000,-0.059131454876034600000000000000,-0.054428980612448100000000000000,-0.049978943537690800000000000000,-0.045778198682063700000000000000,-0.041822783474235300000000000000,-0.038108101063030300000000000000,-0.034628844496444000000000000000,-0.031379067609784400000000000000,-0.028352309330781400000000000000,-0.025541463582971700000000000000,-0.022939002184025600000000000000,-0.020536931927642400000000000000,-0.018326906778052900000000000000,-0.016300233864614200000000000000,-0.014447977456550500000000000000,-0.012761013797587300000000000000,-0.011230096968456600000000000000,-0.009845897329116840000000000000,-0.008599106111698820000000000000,-0.007480456805361260000000000000,-0.006480811548458840000000000000,-0.005591203106199600000000000000,-0.004802884705606330000000000000,-0.004107381800390300000000000000,-0.003496529797545960000000000000,-0.002962511790835340000000000000,-0.002497895097827790000000000000,-0.002095642465522400000000000000,-0.001749144164766310000000000000,-0.001452226492571050000000000000,-0.001199156005068160000000000000,-0.000984645884059421000000000000,-0.000803853057332975000000000000,-0.000652365890788833000000000000,-0.000526197377811481000000000000,-0.000421765573000616000000000000,-0.000335875269465439000000000000,-0.000265697496107741000000000000,-0.000208744027457426000000000000,-0.000162843473142213000000000000,-0.000126115017196543000000000000,-0.000096941682546154300000000000,-0.000073944528008393100000000000,-0.000055957173394240000000000000,-0.000042000893047342300000000000,-0.000031261544648558200000000000,-0.000023067673727618300000000000,-0.000016870564946222700000000000,-0.000012225720625126800000000000,-0.000008776465546161670000000000,-0.000006239475413289330000000000,-0.000004391710999469700000000000,-0.000003059505309136040000000000,-0.000002108959247063990000000000,-0.000001437973393529520000000000,-0.000000969527516995158000000000,-0.000000646178959945180000000000,-0.000000425581255464707000000000,-0.000000276883480436512000000000,-0.000000177885984438156000000000,-0.000000112812196638481000000000,-0.000000070595057463288900000000,-0.000000043573964094702000000000,-0.000000026517971208200100000000,-0.000000015904959271248700000000,-0.000000009397668321212650000000,-0.000000005467793880569670000000,-0.000000003131205254273040000000,-0.000000001764070769768800000000,-0.000000000977281821004985000000,-0.000000000532118211740761000000,-0.000000000284615961604719000000,-0.000000000149467884959283000000,-0.000000000077026254762552700000,-0.000000000038931006569814800000,-0.000000000019287125502863200000,-0.000000000009360572736631610000,-0.000000000004447709105776710000,-0.000000000002067764991425190000,-0.000000000000939982474706208000,-0.000000000000417546243032049000,-0.000000000000181118968958474000,-0.000000000000076664369453846100,-0.000000000000031643347278081500,-0.000000000000012726561071166700,-0.000000000000004983638141969650,-0.000000000000001898690346926380,-0.000000000000000703202796998929,-0.000000000000000252967729420080,-0.000000000000000088316063564998,-0.000000000000000029896625967795,-0.000000000000000009804399136092,-0.000000000000000003111945680753,-0.000000000000000000955076308641,-0.000000000000000000283148427903,-0.000000000000000000081005855556,-0.000000000000000000022340514172,-0.000000000000000000005933043923,-0.000000000000000000001515615975,-0.000000000000000000000371992315,-0.000000000000000000000087619900,-0.000000000000000000000019782021