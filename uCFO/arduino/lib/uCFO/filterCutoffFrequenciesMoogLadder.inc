// Cutoff frequencies for Moog Ladder type lowpass filter in 256 steps

27.50,28.31,29.14,29.99,30.87,31.77,32.70,33.66,34.65,35.66,36.71,37.78,38.89,40.03,41.20,42.41,43.65,44.93,46.25,47.60,49.00,50.44,51.91,53.43,55.00,56.61,58.27,59.98,61.74,63.54,65.41,67.32,69.30,71.33,73.42,75.57,77.78,80.06,82.41,84.82,87.31,89.87,92.50,95.21,98.00,100.87,103.83,106.87,110.00,113.22,116.54,119.96,123.47,127.09,130.81,134.65,138.59,142.65,146.83,151.13,155.56,160.12,164.81,169.64,174.61,179.73,185.00,190.42,196.00,201.74,207.65,213.74,220.00,226.45,233.08,239.91,246.94,254.18,261.63,269.29,277.18,285.30,293.66,302.27,311.13,320.24,329.63,339.29,349.23,359.46,369.99,380.84,392.00,403.48,415.30,427.47,440.00,452.89,466.16,479.82,493.88,508.36,523.25,538.58,554.37,570.61,587.33,604.54,622.25,640.49,659.26,678.57,698.46,718.92,739.99,761.67,783.99,806.96,830.61,854.95,880.00,905.79,932.33,959.65,987.77,1016.71,1046.50,1077.17,1108.73,1141.22,1174.66,1209.08,1244.51,1280.97,1318.51,1357.15,1396.91,1437.85,1479.98,1523.34,1567.98,1613.93,1661.22,1709.90,1760.00,1811.57,1864.66,1919.29,1975.53,2033.42,2093.01,2154.33,2217.46,2282.44,2349.32,2418.16,2489.02,2561.95,2637.02,2714.29,2793.83,2875.69,2959.96,3046.69,3135.96,3227.86,3322.44,3419.79,3520.00,3623.14,3729.31,3838.59,3951.07,4066.84,4186.01,4308.67,4434.92,4564.88,4698.64,4836.32,4978.03,5123.90,5274.04,5428.58,5587.65,5751.38,5919.91,6093.38,6271.93,6455.71,6644.88,6839.59,7040.00,7246.29,7458.62,7677.18,7902.14,8133.69,8372.02,8617.34,8869.85,9129.75,9397.27,9672.64,9956.07,10247.80,10548.09,10857.17,11175.31,11502.77,11839.83,12186.76,12543.86,12911.42,13289.75,13679.17,14080.01,14492.58,14917.25,15354.35,15804.27,16267.37,16744.04,17234.68,17739.69,18259.51,18794.55,19345.28,19912.13,20495.60,21096.17,21714.34,22350.62,23005.54,23679.65,24373.52,25087.72,25822.84,26579.51,27358.35,28160.01,28985.16,29834.49,30708.71,31608.55,32534.75,33488.09,34469.36,35479.39,36519.02,37589.11,38690.55,39824.27,40991.21,42192.34,43428.68